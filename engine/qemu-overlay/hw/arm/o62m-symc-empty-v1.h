#ifndef O62M_SYMC_EMPTY_V1_H
#define O62M_SYMC_EMPTY_V1_H
#include "o62m-te-capabilities-v3.h"
#include <string.h>
/* Explicit fresh host0 SCA/HASH queues. No submitted command is accepted:
 * CQ_FUNC/PARA, CSQ reads and KEY reads remain strict. Thus occupancy/error/
 * finish counts derive from genuinely empty backing, never synthetic work.
 * Virtual policy: HOST_RUN on an empty engine selects INACTIVE; no implicit
 * completion/watermark edge/IRQ/reset/self-clear is generated by config. */
typedef struct O62MSymcEmptyHostV1 {
 uint32_t control,mask[3],suspend;
 uint32_t cq[31],csq[15];
 unsigned cq_words,csq_words;
} O62MSymcEmptyHostV1;
typedef struct O62MSymcEmptyV1 {
 const O62MTeCapabilitiesV3 *caps;
 O62MSymcEmptyHostV1 host[2]; /* 0=SCA,1=HASH */
 bool initialized;
} O62MSymcEmptyV1;
static inline bool o62m_symc_empty_init_v1(O62MSymcEmptyV1 *m,const O62MTeCapabilitiesV3 *caps,
 const uint32_t *words,unsigned count)
{
 uint64_t cq;
 if(!m||!caps||!words||count!=10||
    o62m_te_caps_access_v3(caps,caps->owner,UINT64_C(0x5033000c),4,false,&cq)||
    !(cq&31)||!((cq>>5)&31)||(words[0]&255)||(words[1]&255))return false;
 O62MSymcEmptyV1 next={0};next.caps=caps;next.initialized=true;
 next.host[0].control=words[0];next.host[1].control=words[1];
 for(unsigned n=0;n<2;n++) {
  for(unsigned i=0;i<3;i++)next.host[n].mask[i]=words[2+4*n+i];
  next.host[n].suspend=words[5+4*n];
 }
 *m=next;return true;
}
static inline bool o62m_symc_empty_access_v1(O62MSymcEmptyV1 *m,
 uint64_t address,unsigned size,bool write,uint64_t *value)
{
 if(!m||!value||!m->initialized||!m->caps||size!=4||(address&3)||
    (write&&*value>UINT32_MAX)||
    o62m_te_caps_overlap_v3(m,sizeof(*m),value,sizeof(*value)))return false;
 uint64_t cq;
 if(o62m_te_caps_access_v3(m->caps,m->caps->owner,UINT64_C(0x5033000c),4,false,&cq))return false;
 unsigned n;uint64_t base;
 if(address>=UINT64_C(0x50333200)&&address<UINT64_C(0x50333270)) {n=0;base=UINT64_C(0x50333200);}
 else if(address>=UINT64_C(0x50333280)&&address<UINT64_C(0x503332f0)) {n=1;base=UINT64_C(0x50333280);}
 else return false;
 O62MSymcEmptyHostV1 *h=&m->host[n];unsigned depth=n?(cq&31):((cq>>5)&31);
 if(!depth||h->cq_words||h->csq_words)return false;
 unsigned offset=(unsigned)(address-base);uint32_t *config=NULL;
 if(offset==12)config=&h->control;
 else if(offset>=64&&offset<=72)config=&h->mask[(offset-64)/4];
 else if(offset==108)config=&h->suspend;
 if(config) {if(write)*config=(uint32_t)*value;else *value=*config;return true;}
 if(offset==16) {
  if(write)return false;
  *value=(depth<<11)|((h->control&128)?1u:0u);return true;
 }
 if(offset==20||offset==24||offset==28) {
  /* Initial pending sources are empty; W1C acknowledgments are no-ops.
   * Watermark is an ungenerated event in this explicit no-queue-action
   * policy, never a source of a fabricated interrupt or command result. */
  if(!write)*value=0;return true;
 }
 return false;
}
#endif
